## backport/Kconfig
```kconfig
mainmenu "Linux Backports from $BACKPORTED_KERNEL_NAME $BACKPORTED_KERNEL_VERSION (with backports $BACKPORTS_VERSION)"

config BACKPORT_DIR
	string
	option env="BACKPORT_DIR"
config BACKPORTS_VERSION
	string
	option env="BACKPORTS_VERSION"
config BACKPORTED_KERNEL_VERSION
	string
	option env="BACKPORTED_KERNEL_VERSION"
config BACKPORTED_KERNEL_NAME
	string
	option env="BACKPORTED_KERNEL_NAME"

source "$BACKPORT_DIR/Kconfig.kernel"
source "$BACKPORT_DIR/Kconfig.versions"

# Packaging hacks
source "$BACKPORT_DIR/Kconfig.package.hacks"

# this has the configuration for the backport code
source "$BACKPORT_DIR/compat/Kconfig"

# these are copied from the kernel
source "$BACKPORT_DIR/net/wireless/Kconfig"
source "$BACKPORT_DIR/net/mac80211/Kconfig"
source "$BACKPORT_DIR/net/bluetooth/Kconfig"
source "$BACKPORT_DIR/drivers/net/wireless/Kconfig"
source "$BACKPORT_DIR/drivers/net/ethernet/Kconfig"
source "$BACKPORT_DIR/drivers/net/usb/Kconfig"

source "$BACKPORT_DIR/drivers/ssb/Kconfig"
source "$BACKPORT_DIR/drivers/bcma/Kconfig"

source "$BACKPORT_DIR/net/nfc/Kconfig"

source "$BACKPORT_DIR/drivers/media/Kconfig"

source "$BACKPORT_DIR/net/ieee802154/Kconfig"
source "$BACKPORT_DIR/net/mac802154/Kconfig"
source "$BACKPORT_DIR/drivers/net/ieee802154/Kconfig"

source "$BACKPORT_DIR/drivers/usb/class/Kconfig"
```
